## boards/silabs/radio_boards/xg24_rb4187c/xg24_rb4187c_defconfig
```kconfig
# SPDX-License-Identifier: Apache-2.0

CONFIG_ARM_MPU=y
CONFIG_CONSOLE=y
CONFIG_UART_CONSOLE=y
CONFIG_SERIAL=y
CONFIG_GPIO=y
CONFIG_SOC_GECKO_EMU_DCDC=y
CONFIG_SOC_GECKO_EMU_DCDC_MODE_ON=y
CONFIG_PINCTRL=y

# will be deprecated in turn of CONFIG_BT_SEND_ECC_EMULATION##, PR #79931
CONFIG_BT_TINYCRYPT_ECC=y
```

## drivers/bluetooth/hci/Kconfig.silabs
```kconfig
#
# Copyright 2024 Silicon Laboratories
#
# SPDX-License-Identifier: Apache-2.0
#
config HCI_SILABS_ENABLE_SCAN
	bool "BLE Controller scanning support"
	default y
	help
	  If enabled, The controller supports scanning. Disabling this feature will help
	  on saving flash if application does not need advertisement scanning.
config HCI_SILABS_ENABLE_ADV
	bool "BLE Controller advertisement support"
	default y
	help
	  If enabled, The controller supports sending advertisements. Disabling this feature will help
	  on saving flash if application does not need advertisements.
config HCI_SILABS_ENABLE_CONN
	bool "BLE Controller connection support"
	default y
	help
	  If enabled, The controller supports connections. Disabling this feature will help
	  on saving flash if application does not need advertisements.
```

## drivers/bluetooth/hci/Kconfig.siliconlabs
```kconfig
config BT_SILABS_EFR32_BUFFER_MEMORY
	int "Silicon Labs Bluetooth Library memory buffer size"
	depends on BT_SILABS_EFR32
	default 6144
	help
	  Select the size of allocated memory buffer for the Silicon Labs
	  Bluetooth Library.

config BT_SILABS_EFR32_USER_ADVERTISERS
	int "Silicon Labs Bluetooth Library user advertisement sets"
	depends on BT_SILABS_EFR32
	default 0
	help
	  Amount of advertisement sets reserved for application.

config BT_SILABS_EFR32_ACCEPT_LIST_SIZE
	int "Silicon Labs Bluetooth Library accept list size"
	depends on BT_SILABS_EFR32
	default 1
	help
	  Accept list size.

config BT_SILABS_EFR32_COMPLETED_PACKETS_THRESHOLD
	int "Silicon Labs Bluetooth Library completed packet reporting threshold"
	depends on BT_SILABS_EFR32
	default 1
	help
	   Completed packet reporting threshold value.

config BT_SILABS_EFR32_COMPLETED_PACKETS_TIMEOUT
	int "Silicon Labs Bluetooth Library completed packet report event timeout"
	depends on BT_SILABS_EFR32
	default 3
	help
	  completed packet report event timeout.

config BT_SILABS_EFR32_ACCEPT_LINK_LAYER_STACK_SIZE
	int "Silicon Labs Bluetooth Library link layer stack size"
	depends on BT_SILABS_EFR32
	default 1024
	help
	  Link layer stack size.
```

## tests/bluetooth/tester/boards/xg27_dk2602a.conf
```kconfig
# CONFIG_TEST enforces minimal logging, which we don't want
CONFIG_TEST=n
CONFIG_LOG=n
CONFIG_BT_EXT_ADV=n
CONFIG_BT_ATT_PREPARE_COUNT=2
CONFIG_BT_ATT_TX_COUNT=1
CONFIG_BT_BUF_ACL_RX_COUNT_EXTRA=1
CONFIG_COMMON_LIBC_MALLOC_ARENA_SIZE=4096
CONFIG_BT_DIS=n
CONFIG_CONSOLE=n
CONFIG_BT_BUF_ACL_RX_SIZE=100
```
